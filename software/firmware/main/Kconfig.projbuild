## software/firmware/main/Kconfig.projbuild
```kconfig
menu "Flipdot Firmware Defaults"
    menu "Wireless LAN configuration"
        choice DEFAULT_SYSTEMCONFIGURATION_WIFI_MODE
            bool "Wireless LAN operational mode"
            default DEFAULT_SYSTEMCONFIGURATION_WIFI_MODE_DISABLED
            help
                Select a default mode of operation for the WiFi
            config DEFAULT_SYSTEMCONFIGURATION_WIFI_MODE_DISABLED
                bool "Disable Wireless LAN"
            config DEFAULT_SYSTEMCONFIGURATION_WIFI_MODE_AP
                bool "Operate a Wireless LAN as an access point"
            config DEFAULT_SYSTEMCONFIGURATION_WIFI_MODE_STATION
                bool "Connect to an existing Wireless LAN as a station"
        endchoice
        config DEFAULT_SYSTEMCONFIGURATION_WIFI_SSID
            string "The default Wireless LAN SSID to connect to / operate as an access point"
            default "Fluepdot"
        config DEFAULT_SYSTEMCONFIGURATION_WIFI_PASSWORD
            string "The Wireless LAN pre shared key. Leave blank for none."
            default ""
    endmenu

    menu "RS485 configuration"
        choice DEFAULT_SYSTEMCONFIGURATION_RS485_MODE
            bool "RS485 operational mode"
            default DEFAULT_SYSTEMCONFIGURATION_RS485_MODE_DISABLED
            config DEFAULT_SYSTEMCONFIGURATION_RS485_MODE_DISABLED
                bool "Disable RS485"
            config DEFAULT_SYSTEMCONFIGURATION_RS485_MODE_FLIPNET
                bool "Flipnet mode"
            config DEFAULT_SYSTEMCONFIGURATION_RS485_MODE_DMX
                bool "DMX mode"
        endchoice
        config DEFAULT_SYSTEMCONFIGURATION_RS485_BAUDRATE
            int "Baudrate"
            depends on DEFAULT_SYSTEMCONFIGURATION_RS485_MODE_FLIPNET
        config DEFAULT_SYSTEMCONFIGURATION_RS485_ADDRESS
            int "Address"
            range 0 255
            default 1
            depends on DEFAULT_SYSTEMCONFIGURATION_RS485_MODE_FLIPNET
    endmenu

    menu "Flipdot configuration"
        config DEFAULT_SYSTEMCONFIGURATION_FLIPDOT_PANEL_COUNT
            int "Number of panels"
            range 1 5
            default 5
        config DEFAULT_SYSTEMCONFIGURATION_FLIPDOT_PANEL_SIZE1
            int "Width of panel 1"
            range 20 25
            default 25
        config DEFAULT_SYSTEMCONFIGURATION_FLIPDOT_PANEL_SIZE2
            int "Width of panel 2"
            range 20 25
            default 25
        config DEFAULT_SYSTEMCONFIGURATION_FLIPDOT_PANEL_SIZE3
            int "Width of panel 3"
            range 20 25
            default 20
        config DEFAULT_SYSTEMCONFIGURATION_FLIPDOT_PANEL_SIZE4
            int "Width of panel 4"
            range 20 25
            default 20
        config DEFAULT_SYSTEMCONFIGURATION_FLIPDOT_PANEL_SIZE5
            int "Width of panel 5"
            range 20 25
            default 25
    endmenu

    config DEFAULT_SYSTEMCONFIGURATION_HOSTNAME
        string "The system's hostname"
        default "fluepdot"
endmenu
```

## software/firmware/sdkconfig.defaults
```kconfig
CONFIG_LWIP_STATS=y

CONFIG_SDK_TOOLCHAIN_SUPPORTS_TIME_WIDE_64_BITS=y

# Reduce bootloader log verbosity
CONFIG_BOOTLOADER_LOG_LEVEL_WARN=y
CONFIG_BOOTLOADER_LOG_LEVEL=2

# Increase main task stack size
CONFIG_ESP_MAIN_TASK_STACK_SIZE=7168

# Enable filesystem
CONFIG_PARTITION_TABLE_CUSTOM=y
CONFIG_PARTITION_TABLE_CUSTOM_FILENAME="partitions.csv"
CONFIG_PARTITION_TABLE_FILENAME="partitions.csv"

# Enable FreeRTOS stats formatting functions, needed for 'tasks' command
CONFIG_FREERTOS_USE_TRACE_FACILITY=y
CONFIG_FREERTOS_USE_STATS_FORMATTING_FUNCTIONS=y

CONFIG_ESPTOOLPY_FLASHSIZE_4MB=y

#
# BT config
#
CONFIG_BT_ENABLED=y
CONFIG_BTDM_CTRL_MODE_BLE_ONLY=y
CONFIG_BTDM_CTRL_MODE_BR_EDR_ONLY=n
CONFIG_BTDM_CTRL_MODE_BTDM=n
CONFIG_BT_BLUEDROID_ENABLED=n
CONFIG_BT_NIMBLE_ENABLED=y

CONFIG_MBEDTLS_TLS_CLIENT=y
CONFIG_MBEDTLS_TLS_ENABLED=y
CONFIG_MBEDTLS_CMAC_C=y
```

## software/hello_world/components/flipdot/Kconfig
```kconfig
menu "Flipdot configuration"
    config FLIPDOT_DEFAULT_ONTIME
        int "Rendering cycle duration in microseconds"
        default 1200
    config FLIPDOT_DEFAULT_CLEARTIME
        int "Clear cycle duration in microseconds"
        default 1200

    menu "Panel layout configuration"
        config FLIPDOT_PANEL_COUNT
            int "Number of attached panels"
            default 5
            range 0 6
        config FLIPDOT_PANEL0_WIDTH
            int "Panel's 0 width"
            default 25
    
        config FLIPDOT_PANEL1_WIDTH
            int "Panel's 1 width"
            default 25
    
        config FLIPDOT_PANEL2_WIDTH
            int "Panel's 2 width"
            default 20
    
        config FLIPDOT_PANEL3_WIDTH
            int "Panel's 3 width"
            default 20
    
        config FLIPDOT_PANEL4_WIDTH
            int "Panel's 4 width"
            default 25

        config FLIPDOT_PANEL5_WIDTH
            int "Panel's 5 width"
            default 0

    endmenu
endmenu
```

## software/hello_world/main/Kconfig
```kconfig
menu "Flipdot 'hello world'"
    config WLAN_SSID
        string "The wireless LAN SSID to connect to"
    config WLAN_PSK
        string "The wireless LAN pre shared key. Leave blank for none."
endmenu
```
